## conf/distro/cetibox-base.conf
```bitbake
require conf/distro/poky.conf

# Distro name and version
DISTRO := "cetibox-base"
DISTRO_NAME := "CETiBox H3 Base Level"
DISTRO_VERSION := "V02.00.00"
DISTRO_CODENAME := "Crucial Coffea"
MAINTAINER := "info@cetitec.com"

# SDK config
SDK_TITLE = "${DISTRO_NAME} SDK"
SDK_VERSION = "${DISTRO_VERSION}"
SDK_NAME = "cetibox-x3-${TCLIBC}-${SDK_ARCH}-${IMAGE_BASENAME}-${TUNE_PKGARCH}"
SDKPATH = "/opt/cetitec/cetibox_x3/${DISTRO_VERSION}"
# add the static lib to SDK toolchain
SDKIMAGE_FEATURES = "dev-pkgs dbg-pkgs staticdev-pkgs"
# add kernel source
TOOLCHAIN_TARGET_TASK_append = " kernel-devsrc linux-cetibox-kernel-headers"

# Package config
# Use dropbear ssh
TASK_BASIC_SSHDAEMON := "dropbear"
# Set distro features
DISTRO_FEATURES = "alsa ext2 ipv6 argp largefile usbgadget usbhost wifi xattr pci systemd"
VIRTUAL-RUNTIME_init_manager = "systemd"

# lttng is incompatible with our kernel, don't build
RDEPENDS_packagegroup-core-tools-profile_remove = " \
	lttng-modules \
	lttng-tools \
	lttng-ust \
"

# Don't build/install ltp
RDEPENDS_packagegroup-core-tools-testapps_remove = "ltp"

# Don't install connman, wpa_supplicant, ofono
RDEPENDS_packagegroup-core-tools-testapps_remove = " \
	connman-tools \
	connman-tests \
	connman-client \
	ofono-tests \
"

# We are systemd-only, do not install any sysv init scripts
# Don't need pulseaudio for now
DISTRO_FEATURES_BACKFILL_CONSIDERED = "sysvinit pulseaudio"

# Package kernel device trees for h3
KERNEL_DEVICETREE = " \
	renesas/r8a7795-cetibox-h3ulcb-gweb-v2.dtb \
	renesas/r8a7795-cetibox-h3vc2-nxp.dtb \
	renesas/r8a7795-cetibox-h3vc2-fpga.dtb \
"

PACKAGECONFIG_remove_pn-alsa-plugins = "speexdsp"

# Due to python2/3 incompatibility with old perf (4.14) and new yocto (3.0)
PACKAGECONFIG_remove_pn-perf = "scripting"
```

## conf/machine/cetibox-h3.conf
```bitbake
#@TYPE: Machine
#@NAME: CETiBox H3 machine
#@DESCRIPTION: Machine configuration for running CETiBox H3

DEFAULTTUNE ?= "cortexa57-cortexa53"
SOC_FAMILY = "r8a7795"

require conf/machine/include/tune-cortexa57-cortexa53.inc
require conf/machine/include/${SOC_FAMILY}.inc

# 32BIT package install (default is disable)
# This variables can be used only in multilib.
USE_32BIT_PKGS ?= "0"
USE_32BIT_WAYLAND ?= "0"
USE_32BIT_MMP ?= "0"

MACHINE_FEATURES = ""

# No RTC in cetibox
MACHINE_FEATURES_BACKFILL_CONSIDERED = "rtc"

KERNEL_IMAGETYPE = "Image"
IMAGE_FSTYPES = "tar.bz2"

SERIAL_CONSOLES = "115200;ttySC0"

# Configuration for kernel
PREFERRED_PROVIDER_virtual/kernel = "linux-cetibox"
IMAGE_INSTALL_append = " \
	kernel-devicetree \
"

# Configuration for ARM Trusted Firmware
EXTRA_IMAGEDEPENDS += " arm-trusted-firmware optee-os"

# u-boot
PREFERRED_VERSION_u-boot = "2018.05+rcar+ctc"
PREFERRED_VERSION_u-boot-fw-utils = "2018.05+rcar+ctc"
EXTRA_IMAGEDEPENDS += " u-boot"
UBOOT_CONFIG = "h3ulcb h3vc2-nxp"
UBOOT_CONFIG[h3ulcb] = "r8a7795_cetibox_h3ulcb_defconfig"
UBOOT_CONFIG[h3vc2-nxp] = "r8a7795_cetibox_h3vc2_nxp_defconfig"
PREFERRED_PROVIDER_u-boot-mkimage-native = "u-boot-mkimage-native"

# libdrm
PREFERRED_VERSION_libdrm = "2.4.85"

# Add variable to Build Configuration in build log
BUILDCFG_VARS_append = " SOC_FAMILY"
```
